// KCSM Jazz 91 internet radio + Bluetooth speaker for the AI-Thinker
// ESP32-Audio-Kit V2.2 (ESP32-A1S module, ES8388 codec). Plays out of the
// board's headphone jack, no wiring needed.
//
// Power-up plays KCSM, reconnecting on its own if WiFi or the stream drops.
//   Key5        Bluetooth A on/off (reconnects device A, or waits to pair)
//   Key3        Bluetooth B on/off
//   Key3 (10s)  forget all paired devices
// Bluetooth mode goes back to the radio when the device disconnects, nothing
// connects within 2 minutes, or nothing plays for 10 minutes.
//
// Needs: arduino-esp32 core 3.x, ESP32-audioI2S (schreibfaul1, v4+),
// ESP32-A2DP and arduino-audio-tools (pschatzmann).
// Tools > Board: "ESP32 Dev Module", PSRAM: "Enabled", Partition Scheme: "Huge APP".
// ES8388.cpp/.h are copied from the ESP32-audioI2S ES8388 example. prompts.h/.cpp
// are generated by tools/make_prompts.py.

#include <Arduino.h>
#include <WiFi.h>
#include "secrets.h"  // copy secrets.example.h to secrets.h and fill it in
#include <esp_bt.h>
#include <nvs_flash.h>
#include "Audio.h"
#include "ES8388.h"
#include "board.h"
#include "bluetooth.h"
#include "speaker.h"

// WiFi networks, tried in order until one connects. ESP32 only supports 2.4 GHz.
struct WiFiNetwork { const char* ssid; const char* password; };
const WiFiNetwork WIFI_NETWORKS[] = { WIFI_NETWORK_LIST };  // from secrets.h
const unsigned long WIFI_TIMEOUT_MS = 15000;  // how long to try each network

// AAC+ 64k sounds best. Swap in the MP3 one if AAC stutters (the original ESP32
// has less CPU headroom than the S3, and MP3 is cheaper to decode).
const char* STREAM_URL = "http://ice5.securenetsystems.net/KCSM";
// const char* STREAM_URL = "http://ice7.securenetsystems.net/KCSM2";  // MP3 96k

const char* BT_NAME = "KCSM Radio";

#define VOLUME       21  // 0-21, radio software volume (Bluetooth volume comes from the device)
#define CODEC_VOLUME 62  // 0-62, ES8388 output stage gain (62 is about +3dB)

const unsigned long BT_PAIR_HINT_MS = 15 * 1000;            // remembered device hasn't reconnected
const unsigned long BT_CONNECT_TIMEOUT_MS = 2 * 60 * 1000;  // nothing connected -> radio
const unsigned long BT_IDLE_TIMEOUT_MS = 10 * 60 * 1000;    // connected but not playing -> radio
const unsigned long FORGET_HOLD_MS = 10 * 1000;             // Key3 hold to forget all devices

// Switching modes restarts the chip, so radio and Bluetooth each get a clean
// start instead of handing memory and the I2S output back and forth at runtime.
// These variables survive a restart but not a power cut, so power-up is always radio.
enum Mode : uint32_t { MODE_RADIO, MODE_BT_A, MODE_BT_B };
enum BootAction : uint32_t { BOOT_NONE, BOOT_BACK_TO_RADIO, BOOT_FORGET_ALL };
const uint32_t RTC_MAGIC = 0x4B43534D;  // "KCSM"
RTC_NOINIT_ATTR uint32_t rtcMagic;
RTC_NOINIT_ATTR uint32_t rtcMode;
RTC_NOINIT_ATTR uint32_t rtcBootAction;

Mode mode = MODE_RADIO;
ES8388 codec;
Audio* audio = nullptr;  // radio mode only, created after startup prompts since both use the I2S port
unsigned long lastConnectAttempt = 0;

struct Button {
  uint8_t pin;
  bool down;
  bool armed;  // saw the press, so the release counts (ignores a button still held from before a restart)
  unsigned long changedAt;
};
Button key5 = {KEY5_PIN};
Button key3 = {KEY3_PIN};

enum ButtonEvent { NO_EVENT, PRESSED, RELEASED };

void switchTo(Mode next, BootAction action) {
  Serial.println("Switching mode, restarting...");
  btDisconnect();
  rtcMagic = RTC_MAGIC;
  rtcMode = next;
  rtcBootAction = action;
  ESP.restart();
}

// Pressing the button for the current Bluetooth slot goes back to the radio;
// otherwise it switches to that slot.
void toggleBluetooth(Mode slotMode) {
  if (mode == slotMode) {
    switchTo(MODE_RADIO, BOOT_BACK_TO_RADIO);
  } else {
    switchTo(slotMode, BOOT_NONE);
  }
}

// ---------- Buttons ----------

void initButton(Button& b) {
  pinMode(b.pin, INPUT_PULLUP);
  b.down = digitalRead(b.pin) == LOW;
  b.changedAt = millis();
}

ButtonEvent readButton(Button& b) {
  bool down = digitalRead(b.pin) == LOW;
  if (down == b.down || millis() - b.changedAt < 30) return NO_EVENT;  // 30 ms debounce
  b.down = down;
  b.changedAt = millis();
  if (down) {
    b.armed = true;
    return PRESSED;
  }
  bool wasArmed = b.armed;
  b.armed = false;
  return wasArmed ? RELEASED : NO_EVENT;
}

void checkButtons() {
  if (readButton(key5) == PRESSED) toggleBluetooth(MODE_BT_A);

  // Key3 acts on release, so a long hold can mean "forget all" instead
  ButtonEvent e = readButton(key3);
  if (key3.down && key3.armed && millis() - key3.changedAt >= FORGET_HOLD_MS) {
    Serial.println("Forgetting all devices");
    switchTo(MODE_RADIO, BOOT_FORGET_ALL);
  }
  if (e == RELEASED) toggleBluetooth(MODE_BT_B);
}

// ---------- Radio mode ----------

void audioInfo(Audio::msg_t m) {
  // Logs connection info, codec details and song titles (if the stream sends them)
  Serial.printf("%s: %s\n", m.s, m.msg);
}

bool tryNetwork(const WiFiNetwork& net) {
  WiFi.disconnect();
  WiFi.begin(net.ssid, net.password);
  Serial.printf("Connecting to WiFi \"%s\"", net.ssid);
  unsigned long start = millis();
  while (WiFi.status() != WL_CONNECTED) {
    if (millis() - start > WIFI_TIMEOUT_MS) {
      Serial.println(" failed");
      return false;
    }
    checkButtons();  // Bluetooth still works with no WiFi around
    delay(100);
    Serial.print(".");
  }
  return true;
}

// Blocks until one of WIFI_NETWORKS connects, cycling through them in order.
void connectWiFi() {
  WiFi.mode(WIFI_STA);
  WiFi.setAutoReconnect(false);  // we handle fallback ourselves
  bool announced = false;
  while (true) {
    for (const WiFiNetwork& net : WIFI_NETWORKS) {
      if (tryNetwork(net)) {
        WiFi.setSleep(false);  // WiFi power save causes audio dropouts
        Serial.printf("\nWiFi connected, IP %s\n", WiFi.localIP().toString().c_str());
        return;
      }
    }
    // Only at startup, while the speaker (not the radio library) owns the I2S port
    if (!audio && !announced) {
      say(PROMPT_NO_WIFI);
      announced = true;
    }
  }
}

void startStream() {
  lastConnectAttempt = millis();
  Serial.printf("Connecting to %s\n", STREAM_URL);
  audio->connecttohost(STREAM_URL);
}

void setupRadio(BootAction action) {
  esp_bt_controller_mem_release(ESP_BT_MODE_BTDM);  // Bluetooth is unused until the next restart; free its RAM

  speakerBegin();
  if (action == BOOT_BACK_TO_RADIO) say(PROMPT_BACK_TO_RADIO);
  if (action == BOOT_FORGET_ALL) say(PROMPT_FORGOTTEN);
  connectWiFi();
  speakerEnd();

  Audio::audio_info_callback = audioInfo;
  audio = new Audio();
  audio->setPinout(I2S_BCLK, I2S_LRC, I2S_DOUT, I2S_MCLK);
  audio->setVolume(VOLUME);
  startStream();
}

void radioLoop() {
  audio->loop();

  // If the stream stopped (server hiccup, WiFi blip), retry every 5 seconds
  if (!audio->isRunning() && millis() - lastConnectAttempt > 5000) {
    if (WiFi.status() != WL_CONNECTED) {
      Serial.println("WiFi down, reconnecting...");
      connectWiFi();
    }
    startStream();
  }
}

// ---------- Bluetooth mode ----------

int btSlot;                    // 0 = A, 1 = B
unsigned long btStartedAt;
unsigned long btLastActive;    // last time audio was playing
bool btConnected = false;
bool btPairHintGiven = false;

void setupBluetooth() {
  btSlot = mode == MODE_BT_A ? 0 : 1;
  bool remembered = btSlotHasDevice(btSlot);

  speakerBegin();
  say(btSlot == 0 ? PROMPT_BT_A : PROMPT_BT_B);
  say(remembered ? PROMPT_RECONNECTING : PROMPT_TO_PAIR);
  btPairHintGiven = !remembered;

  Serial.printf("Bluetooth %c as \"%s\"\n", 'A' + btSlot, BT_NAME);
  btStart(btSlot, BT_NAME);
  btStartedAt = millis();
}

void bluetoothLoop() {
  bool connected = btIsConnected();
  if (connected && !btConnected) {
    btConnected = true;
    btLastActive = millis();
    btRememberDevice(btSlot);
    say(btSlot == 0 ? PROMPT_DEVICE_A_CONNECTED : PROMPT_DEVICE_B_CONNECTED);
  } else if (!connected && btConnected) {
    Serial.println("Device disconnected");
    switchTo(MODE_RADIO, BOOT_BACK_TO_RADIO);
  }

  if (btConnected) {
    if (btIsPlaying()) {
      btLastActive = millis();
    } else if (millis() - btLastActive > BT_IDLE_TIMEOUT_MS) {
      Serial.println("Nothing played for a while");
      switchTo(MODE_RADIO, BOOT_BACK_TO_RADIO);
    }
    return;
  }

  if (!btPairHintGiven && millis() - btStartedAt > BT_PAIR_HINT_MS) {
    say(PROMPT_PAIR_NEW);
    btPairHintGiven = true;
  }
  if (millis() - btStartedAt > BT_CONNECT_TIMEOUT_MS) {
    Serial.println("Nothing connected");
    switchTo(MODE_RADIO, BOOT_BACK_TO_RADIO);
  }
}

// ----------

void setup() {
  Serial.begin(115200);

  bool switched = esp_reset_reason() == ESP_RST_SW && rtcMagic == RTC_MAGIC;
  mode = switched ? (Mode)rtcMode : MODE_RADIO;
  BootAction action = switched ? (BootAction)rtcBootAction : BOOT_NONE;
  rtcMagic = 0;  // a crash or reset button press after this starts in radio mode

  if (action == BOOT_FORGET_ALL) {
    // Clears the Bluetooth pairings, our device slots and the A2DP library's
    // reconnect address; everything else the sketch needs is in the code.
    nvs_flash_erase();
    nvs_flash_init();
  }

  delay(500);
  Serial.printf("\nKCSM radio. PSRAM: %u bytes\n", ESP.getPsramSize());
  if (ESP.getPsramSize() == 0) {
    Serial.println("WARNING: no PSRAM found. Set Tools > PSRAM to \"Enabled\" and re-upload.");
  }

  initButton(key5);
  initButton(key3);

  Serial.print("Starting ES8388 codec... ");
  while (!codec.begin(I2C_SDA, I2C_SCL)) {
    Serial.print("not found, retrying... ");
    delay(1000);
  }
  Serial.println("OK");
  codec.SetVolumeHeadphone(CODEC_VOLUME);
  codec.SetVolumeSpeaker(CODEC_VOLUME);
  pinMode(PA_ENABLE, OUTPUT);
  digitalWrite(PA_ENABLE, HIGH);

  if (mode == MODE_RADIO) {
    setupRadio(action);
  } else {
    setupBluetooth();
  }
}

void loop() {
  checkButtons();
  if (mode == MODE_RADIO) {
    radioLoop();
  } else {
    bluetoothLoop();
  }
  vTaskDelay(1);
}
